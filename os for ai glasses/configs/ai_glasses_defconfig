## os for ai glasses/configs/ai_glasses_defconfig
```kconfig
FROM debian:stable-slim

# (Optional) Install buildroot dependencies if needed
RUN apt-get update && apt-get install -y build-essential git wget bc bison flex python3

# Copy your defconfig into the container
COPY ai_glasses_defconfig /workspace/ai_glasses_defconfig

WORKDIR /workspace

# (Optional) Add buildroot build steps here

# (Buildroot defconfig options have been removed from the Dockerfile. Place them in a separate defconfig file instead.)
BR2_x86_64=y
BR2_TOOLCHAIN_BUILDROOT_GLIBC=y
BR2_SYSTEM_DHCP="eth0"
BR2_TARGET_GENERIC_GETTY_PORT="tty1"
BR2_PACKAGE_DROPBEAR=y
BR2_PACKAGE_WAV=y
BR2_PACKAGE_PULSEAUDIO=y
BR2_PACKAGE_WHISPER_CPP=y
BR2_PACKAGE_LLAMA_CPP=y
BR2_PACKAGE_OPENCV=y
BR2_ROOTFS_OVERLAY="rootfs_overlay"
BR2_PACKAGE_LIBGL=y
BR2_PACKAGE_LIBGLU=y    
BR2_PACKAGE_LIBEGL=y
BR2_PACKAGE_GSTREAMER=y
BR2_PACKAGE_GSTREAMER_PLUGINS_BASE=y
BR2_PACKAGE_GSTREAMER_PLUGINS_GOOD=y    
BR2_PACKAGE_GSTREAMER_PLUGINS_BAD=y
BR2_PACKAGE_GSTREAMER_PLUGINS_UGLY=y
BR2_PACKAGE_GSTREAMER_PLUGINS_BASE_GST1_PLUGIN_SCANNER=y
BR2_PACKAGE_GSTREAMER_PLUGINS_BASE_GST1_PLUGIN_SCANNER=y
```

## os for ai glasses/package/whisper_cpp/config.in
```kconfig
config BR2_PACKAGE_WHISPER_CPP
    bool "whisper.cpp"
    help
      Lightweight speech-to-text engine from whisper.cpp
```
